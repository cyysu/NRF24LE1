/****************************************Copyright (c)****************************************************
**                                        
**                                 
**
**--------------File Info---------------------------------------------------------------------------------
** File name:			main.c
** Last modified Date: 2015-4-16         
** Last Version:		   1.2
** Descriptions:							
**--------------------------------------------------------------------------------------------------------
** Created by:			FiYu
** Created date:		2014-11-12
** Version:			    1.0
** Descriptions:		GPIO按键输入检测实验					
**--------------------------------------------------------------------------------------------------------
** Modified by:			FiYu
** Modified date:		
** Version:				
** Descriptions:		
** Rechecked by:			
**********************************************************************************************************/
#include <stdio.h> 
#include <reg24le1.h>
#include <stdint.h>
#include "hal_delay.h"


/*-------------------管脚定义--------------------------------------------------*/
#define  D1    P00  // 开发板上的指示灯D1
#define  D2    P01  // 开发板上的指示灯D2
#define  S1    P12  // 开发板上的按键S1
#define  S2    P13  // 开发板上的按键S2


/* 开发板中nRF24LE1管脚配置
P00：输出，驱动D1	       P12：输入，按键检测S1  
P01：输出，驱动D2			   P13：输入，按键检测S2
P02：输出，OLED时钟			 P14：输出，OLED数据
P03：输出，UART TXD			 P15：输出，OLED片选
P04：输入，UART RXD			 P16：输出，OLED命令/数据选择
P06：输入，AIN6  AD检测  蜂鸣器驱动(通过跳线选择)
*/

/*******************************************************************************************************
 * 描  述 : 配置 IO P0.0和P0.1为输出，P1.2和P1.3为输入
 * 入  参 : 无
 * 返回值 : 无
 *******************************************************************************************************/
void IO_Init(void)
{	
	P0DIR &= ~0x03;	   //配置P0.0和P0.1为输出
	P1DIR |= 0x0c;	   //配置P1.2和P1.3为输入
	D1 = 1;            //设置D1初始状态为熄灭
	D2 = 1;	           //设置D2初始状态为熄灭
}
/*******************************************************************************************************
 * 描  述 : 主函数
 * 入  参 : 无
 * 返回值 : 无
 *******************************************************************************************************/
void main(void)
{ 
  IO_Init();

  while(1)
  {
	  if(S1 == 0)
	  {
	    delay_ms(10);
	    if(S1 == 0)	     //按键1按下
	    {
		    D1 = 0;	       //点亮D1
		    while(S1 == 0); //等待按键释放
		    D1 = 1;
	    }
	  }

	  if(S2 == 0)
	  {
	    delay_ms(10);
	    if(S2 == 0)	     //按键2按下
	    {
		    D2 = 0;	     //点亮D2
		    while(S2 == 0); //等待按键释放
		    D2 = 1;
	    }
	  } 
  }
}

/*********************************END FILE****************************************************************/	