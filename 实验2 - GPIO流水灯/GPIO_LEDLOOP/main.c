/****************************************Copyright (c)****************************************************
**                                        
**                                 
**
**--------------File Info---------------------------------------------------------------------------------
** File name:			main.c
** Last modified Date: 2015-4-16         
** Last Version:		   1.2
** Descriptions:							
**--------------------------------------------------------------------------------------------------------
** Created by:			FiYu
** Created date:		2014-11-12
** Version:			    1.0
** Descriptions:		GPIO流水灯实验				
**--------------------------------------------------------------------------------------------------------
** Modified by:			FiYu
** Modified date:		
** Version:				
** Descriptions:		
** Rechecked by:			
**********************************************************************************************************/
#include <reg24le1.h>
#include <stdio.h> 
#include <stdint.h>
#include <stdbool.h>
#include "hal_delay.h"


/*-------------------管脚定义--------------------------------------------------*/
#define  D1    P00  // 开发板上的指示灯D1
#define  D2    P01  // 开发板上的指示灯D2

/* 开发板中nRF24LE1管脚配置
P00：输出，驱动D1	       P12：输入，按键检测S1  
P01：输出，驱动D2			   P13：输入，按键检测S2
P02：输出，OLED时钟			 P14：输出，OLED数据
P03：输出，UART TXD			 P15：输出，OLED片选
P04：输入，UART RXD			 P16：输出，OLED命令/数据选择
P06：输入，AIN6  AD检测  蜂鸣器驱动(通过跳线选择)
*/

/*******************************************************************************************************
 * 描  述 : 配置 IO P0.0和P0.1
 * 入  参 : 无
 * 返回值 : 无
 *******************************************************************************************************/
void IO_Init(void)
{	
	P0DIR &= ~0x03;	   //配置P0.0和P0.1为输出
	D1 = 1;            //设置D1初始状态为熄灭
	D2 = 1;	           //设置D2初始状态为熄灭
}
/*******************************************************************************************************
 * Description : main loop
 * Parameters  : none
 * Return      : none
 *******************************************************************************************************/
void main(void)
{ 
  uint8_t i;
	
  IO_Init();

  while(true)
  {
	  for(i=0; i<4; i++)
		{
			D1 = ~D1;        //指示灯D1状态取反
		  delay_ms(100);   //延时200ms
		  D2 = ~D2;        //指示灯D2状态取反
		  delay_ms(100);	 
		}
		delay_ms(300);	
		for(i=0; i<6; i++)
		{
			D1 = ~D1;          
		  D2 = ~D2;
		  delay_ms(100);	 
		}   
  }
}

 /*********************************END FILE****************************************************************/	