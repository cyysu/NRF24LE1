/****************************************Copyright (c)****************************************************
**                                        
**                                 
**
**--------------File Info---------------------------------------------------------------------------------
** File name:			main.c
** Last modified Date: 2015-4-16         
** Last Version:		1.2
** Descriptions:							
**--------------------------------------------------------------------------------------------------------
** Created by:			FiYu
** Created date:		2014-11-12
** Version:			    1.0
** Descriptions:		休眠-RTC唤醒实验程序				
**--------------------------------------------------------------------------------------------------------
** Modified by:			FiYu
** Modified date:		
** Version:				
** Descriptions:		
** Rechecked by:			
**********************************************************************************************************/
#include <stdio.h> 
#include <reg24le1.h>
#include <stdint.h>
#include "hal_clk.h"
#include "hal_delay.h"
#include "hal_rtc.h"


/*-------------------管脚定义--------------------------------------------------*/
#define  D1    P00  // 开发板上的指示灯D1


/* 开发板上nRF24LE1管脚配置
P00：输出，驱动D4	         P12：输入，按键检测S2  
P01：输出，驱动D5			     P13：输入，按键检测S3
P02：输出					         P14：输出
P03：输出，UART TXD			   P15：输出
P04：输入，UART RXD			   P16：输出
P06：输入，AIN6  AD检测
*/
						 
#define SLEEPTIME  32768     // 休眠时间1秒


/*******************************************************************************************************
 * 描  述 : 配置 IO P0.0和P0.1为输出驱动LED
 * 入  参 : 无
 * 返回值 : 无
 *******************************************************************************************************/
void IO_Init(void)
{	
	P0DIR &= ~0x01;	   //配置P0.0和P0.1为输出
	D1 = 1;            //设置D1初始状态为熄灭
}

/*******************************************************************************************************
 * 描  述 : 设置休眠时间
 * 入  参 : period:休眠时间
 * 返回值 : 无
 *******************************************************************************************************/
void set_timer_period(uint16_t period)
{
  hal_rtc_start(false);                             
  hal_rtc_start(true);                              // Start/stop to reset counter  
  hal_rtc_set_compare_value(period - 1);
}

/*******************************************************************************************************
 * 描  述 : 时钟和RTC唤醒配置
 * 入  参 : 无
 * 返回值 : 无
 *******************************************************************************************************/
void mcu_init(void)
{
  hal_rtc_start(false);                             //关闭32.768KHz时钟
  hal_clklf_set_source(HAL_CLKLF_RCOSC32K);         //32.768KHz的时钟源为内部RC	   

  hal_rtc_set_compare_mode(HAL_RTC_COMPARE_MODE_0); //32KHz 模式0
  set_timer_period(SLEEPTIME);	                    //设置休眠时间
  hal_clk_set_16m_source(HAL_CLK_XOSC16M);          //使用外部16MHz晶振
  hal_clk_regret_xosc16m_on(0);                     //在寄存器维持低功耗模式下关闭16MHz时钟

  hal_rtc_start(true);                              //启动32.768KHz时钟
	
  while((CLKLFCTRL&0x80)==0x80);	                  //等待时钟启动完成
  while((CLKLFCTRL&0x80)!=0x80);
}

/*******************************************************************************************************
 * 描  述 : 主函数
 * 入  参 : 无
 * 返回值 : 无
 *******************************************************************************************************/ 
void main(void)
{ 
  IO_Init();
  
  mcu_init();

  while(1)
  {		  
	  PWRDWN = 0x04; // 进入寄存器维持低功耗模式
	  PWRDWN = 0x00;
		
		D1 = ~D1; //休眠唤醒后D1指示灯状态取反
  }
}
 /*********************************END FILE****************************************************************/	